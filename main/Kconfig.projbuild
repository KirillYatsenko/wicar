## main/Kconfig.projbuild
```kconfig
menu "WIFI AP"

config SSID
    string "Wi-Fi name (SSID)"
    default "wicar"
    
config PASSWORD
    string "Wi-Fi password"
    default "12345678"

endmenu
```
